## build/left/Kconfig/Kconfig.modules
```kconfig
menu "nanopb (/Users/tkd_usk/src/zmk-workspace-dya/modules/lib/nanopb)"
osource "$(ZEPHYR_NANOPB_KCONFIG)"
config ZEPHYR_NANOPB_MODULE
	bool
	default y
endmenu
menu "acpica (/Users/tkd_usk/src/zmk-workspace-dya/modules/lib/acpica)"
osource "$(ZEPHYR_ACPICA_KCONFIG)"
config ZEPHYR_ACPICA_MODULE
	bool
	default y
endmenu
menu "canopennode (/Users/tkd_usk/src/zmk-workspace-dya/modules/lib/canopennode)"
osource "$(ZEPHYR_CANOPENNODE_KCONFIG)"
config ZEPHYR_CANOPENNODE_MODULE
	bool
	default y
endmenu
menu "cmsis (/Users/tkd_usk/src/zmk-workspace-dya/modules/hal/cmsis)"
osource "$(ZEPHYR_CMSIS_KCONFIG)"
config ZEPHYR_CMSIS_MODULE
	bool
	default y
endmenu
menu "cmsis-dsp (/Users/tkd_usk/src/zmk-workspace-dya/modules/lib/cmsis-dsp)"
osource "$(ZEPHYR_CMSIS_DSP_KCONFIG)"
config ZEPHYR_CMSIS_DSP_MODULE
	bool
	default y
endmenu
menu "cmsis-nn (/Users/tkd_usk/src/zmk-workspace-dya/modules/lib/cmsis-nn)"
osource "$(ZEPHYR_CMSIS_NN_KCONFIG)"
config ZEPHYR_CMSIS_NN_MODULE
	bool
	default y
endmenu
menu "fatfs (/Users/tkd_usk/src/zmk-workspace-dya/modules/fs/fatfs)"
osource "$(ZEPHYR_FATFS_KCONFIG)"
config ZEPHYR_FATFS_MODULE
	bool
	default y
endmenu
menu "hal_ambiq (/Users/tkd_usk/src/zmk-workspace-dya/modules/hal/ambiq)"
osource "$(ZEPHYR_HAL_AMBIQ_KCONFIG)"
config ZEPHYR_HAL_AMBIQ_MODULE
	bool
	default y
endmenu
menu "hal_espressif (/Users/tkd_usk/src/zmk-workspace-dya/modules/hal/espressif)"
osource "/Users/tkd_usk/src/zmk-workspace-dya/modules/hal/espressif/zephyr/Kconfig"
config ZEPHYR_HAL_ESPRESSIF_MODULE
	bool
	default y
endmenu
menu "hal_ethos_u (/Users/tkd_usk/src/zmk-workspace-dya/modules/hal/ethos_u)"
osource "$(ZEPHYR_HAL_ETHOS_U_KCONFIG)"
config ZEPHYR_HAL_ETHOS_U_MODULE
	bool
	default y
endmenu
menu "hal_gigadevice (/Users/tkd_usk/src/zmk-workspace-dya/modules/hal/gigadevice)"
osource "$(ZEPHYR_HAL_GIGADEVICE_KCONFIG)"
config ZEPHYR_HAL_GIGADEVICE_MODULE
	bool
	default y
endmenu
menu "hal_nordic (/Users/tkd_usk/src/zmk-workspace-dya/modules/hal/nordic)"
osource "$(ZEPHYR_HAL_NORDIC_KCONFIG)"
config ZEPHYR_HAL_NORDIC_MODULE
	bool
	default y
endmenu
menu "hal_rpi_pico (/Users/tkd_usk/src/zmk-workspace-dya/modules/hal/rpi_pico)"
osource "$(ZEPHYR_HAL_RPI_PICO_KCONFIG)"
config ZEPHYR_HAL_RPI_PICO_MODULE
	bool
	default y
endmenu
menu "hal_telink (/Users/tkd_usk/src/zmk-workspace-dya/modules/hal/telink)"
osource "/Users/tkd_usk/src/zmk-workspace-dya/modules/hal/telink/Kconfig"
config ZEPHYR_HAL_TELINK_MODULE
	bool
	default y
endmenu
menu "liblc3 (/Users/tkd_usk/src/zmk-workspace-dya/modules/lib/liblc3)"
osource "$(ZEPHYR_LIBLC3_KCONFIG)"
config ZEPHYR_LIBLC3_MODULE
	bool
	default y
endmenu
menu "littlefs (/Users/tkd_usk/src/zmk-workspace-dya/modules/fs/littlefs)"
osource "$(ZEPHYR_LITTLEFS_KCONFIG)"
config ZEPHYR_LITTLEFS_MODULE
	bool
	default y
endmenu
menu "lvgl (/Users/tkd_usk/src/zmk-workspace-dya/modules/lib/gui/lvgl)"
osource "/Users/tkd_usk/src/zmk-workspace-dya/modules/lib/gui/lvgl/Kconfig"
config ZEPHYR_LVGL_MODULE
	bool
	default y
endmenu
menu "mbedtls (/Users/tkd_usk/src/zmk-workspace-dya/modules/crypto/mbedtls)"
osource "$(ZEPHYR_MBEDTLS_KCONFIG)"
config ZEPHYR_MBEDTLS_MODULE
	bool
	default y
endmenu
menu "percepio (/Users/tkd_usk/src/zmk-workspace-dya/modules/debug/percepio)"
osource "/Users/tkd_usk/src/zmk-workspace-dya/modules/debug/percepio/zephyr/Kconfig"
config ZEPHYR_PERCEPIO_MODULE
	bool
	default y
endmenu
menu "picolibc (/Users/tkd_usk/src/zmk-workspace-dya/modules/lib/picolibc)"
osource "/Users/tkd_usk/src/zmk-workspace-dya/modules/lib/picolibc/zephyr/Kconfig"
config ZEPHYR_PICOLIBC_MODULE
	bool
	default y
endmenu
menu "segger (/Users/tkd_usk/src/zmk-workspace-dya/modules/debug/segger)"
osource "$(ZEPHYR_SEGGER_KCONFIG)"
config ZEPHYR_SEGGER_MODULE
	bool
	default y
endmenu
menu "trusted-firmware-a (/Users/tkd_usk/src/zmk-workspace-dya/modules/tee/tf-a/trusted-firmware-a)"
osource "$(ZEPHYR_TRUSTED_FIRMWARE_A_KCONFIG)"
config ZEPHYR_TRUSTED_FIRMWARE_A_MODULE
	bool
	default y
endmenu
menu "uoscore-uedhoc (/Users/tkd_usk/src/zmk-workspace-dya/modules/lib/uoscore-uedhoc)"
osource "$(ZEPHYR_UOSCORE_UEDHOC_KCONFIG)"
config ZEPHYR_UOSCORE_UEDHOC_MODULE
	bool
	default y
endmenu
menu "zcbor (/Users/tkd_usk/src/zmk-workspace-dya/modules/lib/zcbor)"
osource "$(ZEPHYR_ZCBOR_KCONFIG)"
config ZEPHYR_ZCBOR_MODULE
	bool
	default y
endmenu
menu "zmk-pmw3610-driver (/Users/tkd_usk/src/zmk-modules-mona2/zmk-pmw3610-driver)"
osource "/Users/tkd_usk/src/zmk-modules-mona2/zmk-pmw3610-driver/Kconfig"
config ZEPHYR_ZMK_PMW3610_DRIVER_MODULE
	bool
	default y
endmenu
menu "zmk-rgbled-widget (/Users/tkd_usk/src/zmk-modules-mona2/zmk-rgbled-widget)"
osource "/Users/tkd_usk/src/zmk-modules-mona2/zmk-rgbled-widget/Kconfig"
config ZEPHYR_ZMK_RGBLED_WIDGET_MODULE
	bool
	default y
endmenu
menu "zmk-input-processor-keybind (/Users/tkd_usk/src/zmk-modules-mona2/zmk-input-processor-keybind)"
osource "/Users/tkd_usk/src/zmk-modules-mona2/zmk-input-processor-keybind/Kconfig"
config ZEPHYR_ZMK_INPUT_PROCESSOR_KEYBIND_MODULE
	bool
	default y
endmenu
menu "zmk-module-ble-management (/Users/tkd_usk/src/zmk-modules-dya/zmk-module-ble-management)"
osource "/Users/tkd_usk/src/zmk-modules-dya/zmk-module-ble-management/Kconfig"
config ZEPHYR_ZMK_MODULE_BLE_MANAGEMENT_MODULE
	bool
	default y
endmenu
menu "zmk-module-settings-rpc (/Users/tkd_usk/src/zmk-modules-dya/zmk-module-settings-rpc)"
osource "/Users/tkd_usk/src/zmk-modules-dya/zmk-module-settings-rpc/Kconfig"
config ZEPHYR_ZMK_MODULE_SETTINGS_RPC_MODULE
	bool
	default y
endmenu
menu "zmk-module-runtime-input-processor (/Users/tkd_usk/src/zmk-modules-dya/zmk-module-runtime-input-processor)"
osource "/Users/tkd_usk/src/zmk-modules-dya/zmk-module-runtime-input-processor/Kconfig"
config ZEPHYR_ZMK_MODULE_RUNTIME_INPUT_PROCESSOR_MODULE
	bool
	default y
endmenu
menu "zmk-behavior-runtime-sensor-rotate (/Users/tkd_usk/src/zmk-modules-dya/zmk-behavior-runtime-sensor-rotate)"
osource "/Users/tkd_usk/src/zmk-modules-dya/zmk-behavior-runtime-sensor-rotate/Kconfig"
config ZEPHYR_ZMK_BEHAVIOR_RUNTIME_SENSOR_ROTATE_MODULE
	bool
	default y
endmenu
menu "module (/Users/tkd_usk/src/zmk-workspace-dya/zmk/app/module)"
osource "/Users/tkd_usk/src/zmk-workspace-dya/zmk/app/module/Kconfig"
config ZEPHYR_MODULE_MODULE
	bool
	default y
endmenu
```

## build/left/Kconfig/Kconfig.shield.defconfig
```kconfig
osource "/Users/tkd_usk/src/zmk-config-moNa2-v2-dya/boards/shields/*/Kconfig.defconfig"
osource "/Users/tkd_usk/src/zmk-modules-mona2/zmk-rgbled-widget/boards/shields/*/Kconfig.defconfig"
osource "/Users/tkd_usk/src/zmk-modules-dya/zmk-module-ble-management/boards/shields/*/Kconfig.defconfig"
osource "/Users/tkd_usk/src/zmk-modules-dya/zmk-module-settings-rpc/boards/shields/*/Kconfig.defconfig"
osource "/Users/tkd_usk/src/zmk-modules-dya/zmk-module-runtime-input-processor/boards/shields/*/Kconfig.defconfig"
osource "/Users/tkd_usk/src/zmk-modules-dya/zmk-behavior-runtime-sensor-rotate/boards/shields/*/Kconfig.defconfig"
osource "/Users/tkd_usk/src/zmk-workspace-dya/zmk/app/boards/shields/*/Kconfig.defconfig"
```

## zmk-input-processor-gestures/dts/bindings/input_processors/zmk,input-processor-gestures.yaml
```yaml
# Copyright (c) 2026 The ZMK Contributors
# SPDX-License-Identifier: MIT

description: Input processor for turning relative XY movement into directional behavior taps

compatible: "zmk,input-processor-gestures"

include: ip_zero_param.yaml

properties:
  "#input-processor-cells":
    type: int
    const: 0
  type:
    type: int
  x-code:
    type: int
  y-code:
    type: int
  threshold:
    type: int
    description: "Minimum displacement (in REL units) to trigger a gesture (default: 120)"
  timeout-ms:
    type: int
    description: "Time window in ms to accumulate displacement (default: 180)"
  cooldown-ms:
    type: int
    description: "Cooldown in ms between consecutive gestures (default: 220)"
  tap-ms:
    type: int
    description: "Duration in ms for the triggered key tap (default: 30)"
  layer-id:
    type: int
    required: true
    description: "Keymap layer to read behavior bindings from"
  positions:
    type: array
    required: true
    description: "Key positions for [up, down, left, right] gestures"
  active-layers:
    type: int
    description: "Bitmask of layers on which this processor is active. 0 (default) means active on all layers."
```
